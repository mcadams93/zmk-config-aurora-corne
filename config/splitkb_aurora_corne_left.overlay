#include "splitkb_aurora_corne.dtsi"

&glidepoint_listener {
    status = "okay";
};

// nice!view CS (pro_micro 1 = P0.06) collides with the underglow SPI3 MOSI; underglow is unused.
&spi3 {
    status = "disabled";
};
